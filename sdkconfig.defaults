## sdkconfig.defaults
```kconfig
CONFIG_IDF_TARGET="esp32c3"
CONFIG_IDF_TARGET_ESP32C3=y

# Optimize for size
CONFIG_COMPILER_OPTIMIZATION_SIZE=y
CONFIG_COMPILER_OPTIMIZATION_LEVEL="-Os"
CONFIG_COMPILER_OPTIMIZATION_ASSERTIONS_DISABLE=y
CONFIG_COMPILER_OPTIMIZATION_CHECKS_SILENT=y

# Minimal logging
CONFIG_LOG_DEFAULT_LEVEL_NONE=y
CONFIG_LOG_MAXIMUM_LEVEL=0
CONFIG_BOOTLOADER_LOG_LEVEL_NONE=y

# Disable unused features
CONFIG_VFS_SUPPORT_TERMIOS=n
CONFIG_VFS_SUPPORT_SELECT=n
CONFIG_VFS_SUPPORT_IOCTL=n
CONFIG_VFS_SUPPORT_DIR=n
CONFIG_LWIP_ENABLE=n
CONFIG_WIFI_ENABLED=n
CONFIG_BT_CLASSIC_ENABLED=n

# NimBLE configuration - peripheral only, minimal
CONFIG_BT_NIMBLE_ENABLED=y
CONFIG_BT_NIMBLE_ROLE_PERIPHERAL=y
CONFIG_BT_NIMBLE_ROLE_CENTRAL=n
CONFIG_BT_NIMBLE_ROLE_BROADCASTER=n
CONFIG_BT_NIMBLE_ROLE_OBSERVER=n
CONFIG_BT_NIMBLE_MAX_CONNECTIONS=1
CONFIG_BT_NIMBLE_MAX_BONDS=0
CONFIG_BT_NIMBLE_MAX_CCCDS=0
CONFIG_BT_NIMBLE_L2CAP_COC_MAX_NUM=0
CONFIG_BT_NIMBLE_GATT_MAX_SERVICES=1
CONFIG_BT_NIMBLE_GATT_MAX_ATTRS=8
CONFIG_BT_NIMBLE_HS_FLOW_CTRL=n
CONFIG_BT_NIMBLE_HS_FLOW_CTRL_ITVL=0
CONFIG_BT_NIMBLE_HS_FLOW_CTRL_THRESH=0
CONFIG_BT_NIMBLE_HS_FLOW_CTRL_TX_ON_DISCONNECT=n
CONFIG_BT_NIMBLE_RPA_TIMEOUT=0
CONFIG_BT_NIMBLE_MESH=n
CONFIG_BT_NIMBLE_CRYPTO_STACK_MBEDTLS=y
CONFIG_BT_NIMBLE_SM_LEGACY=n
CONFIG_BT_NIMBLE_SM_SC=n
CONFIG_BT_NIMBLE_SM_SC_DEBUG_KEYS=n
CONFIG_BT_NIMBLE_KEY_SIZE=16

# Bluetooth controller config - minimal
CONFIG_BT_CONTROLLER_BLE_MAX_CONN=1
CONFIG_BT_CONTROLLER_BLE_MAX_ACT=0
CONFIG_BT_CONTROLLER_BLE_HW_FEAT_EN=n
CONFIG_BT_CONTROLLER_BLE_DUP_SCAN_FILTER=n
CONFIG_BT_CONTROLLER_BLE_ADV_REPORT_FLOW_CTRL=n
CONFIG_BT_CONTROLLER_BLE_ADV_REPORT_DISCARD_THRESHOLD=0
CONFIG_BT_CONTROLLER_BLE_SCAN_DUPL_TYPE=0
CONFIG_BT_CONTROLLER_BLE_SCAN_DUPL_CACHE_SIZE=0
CONFIG_BT_CONTROLLER_BLE_SCAN_DUPL_WINDOW=0
CONFIG_BT_CONTROLLER_BLE_MESH=n
CONFIG_BT_CONTROLLER_BLE_50_FEATURES_SUPPORT=n

# Memory optimization
CONFIG_BT_BLUEDROID_ENABLED=n
CONFIG_BT_NIMBLE_MEM_ALLOC_MODE_INTERNAL=y
CONFIG_BT_NIMBLE_MSYS_BUF_COUNT=8
CONFIG_BT_NIMBLE_MSYS_BUF_SIZE=256

# Disable unnecessary features
CONFIG_APP_ROLLBACK_ENABLE=n
CONFIG_BOOTLOADER_APP_ROLLBACK_ENABLE=n
CONFIG_BOOTLOADER_WDT_ENABLE=n
CONFIG_ESP_TASK_WDT=n
CONFIG_ESP_INT_WDT=n
CONFIG_ESP_SYSTEM_PANIC_SILENT_REBOOT=y
CONFIG_ESP_SYSTEM_PANIC_GDBSTUB=n
CONFIG_ESP_SYSTEM_PANIC_PRINT_REBOOT=n
CONFIG_ESP_PANIC_HANDLER_IRAM=n
CONFIG_DEBUG_UART=n
CONFIG_LOG_BOOTLOADER_LEVEL_NONE=y

# Partition table
CONFIG_PARTITION_TABLE_CUSTOM=y
CONFIG_PARTITION_TABLE_CUSTOM_FILENAME="partition_table/partitions.csv"
CONFIG_PARTITION_TABLE_OFFSET=0x8000
CONFIG_PARTITION_TABLE_MD5=y

# Flash config
CONFIG_ESPTOOLPY_FLASHSIZE_4MB=y
CONFIG_ESPTOOLPY_FLASHMODE_QIO=y
CONFIG_ESPTOOLPY_FLASHFREQ_80M=y
CONFIG_ESPTOOLPY_BEFORE_DEFAULT_RESET=y
CONFIG_ESPTOOLPY_AFTER_HARD_RESET=y

# Disable printf floating point
CONFIG_NEWLIB_NANO_FORMAT=y

# Disable brownout detector
CONFIG_ESP_BROWNOUT_DET=n
CONFIG_ESP_BROWNOUT_DET_LVL_SEL_0=n

# XIP flash config
CONFIG_SPI_FLASH_CACHE2RAM_SIZE=0

# Disable esp_http_server
CONFIG_ESP_HTTP_SERVER=n

# Disable NVS encryption
CONFIG_NVS_ENCRYPTION=n

# Disable core dump
CONFIG_ESP_COREDUMP_ENABLE_TO_NONE=y

# Minimize IRAM usage
CONFIG_FREERTOS_TASK_FUNCTION_WRAPPER=n
CONFIG_FREERTOS_CHECK_STACKOVERFLOW_NONE=y
CONFIG_FREERTOS_WATCHPOINT_END_OF_STACK=n
CONFIG_FREERTOS_INTERRUPT_BACKTRACE=n

# Minimize startup time
CONFIG_BOOTLOADER_SKIP_VALIDATE_IN_DEEP_SLEEP=y
CONFIG_BOOTLOADER_SKIP_VALIDATE_ON_POWER_ON=y
CONFIG_BOOTLOADER_SKIP_FLASH_CONFIG=y

# Disable panic handling features
CONFIG_ESP_SYSTEM_ALLOW_RTC_FAST_MEM_AS_HEAP=n
CONFIG_ESP_SYSTEM_MEMPROT_FEATURE=n
CONFIG_ESP_SYSTEM_MEMPROT_FEATURE_LOCK=n
```
